## layers/meta-balena-allwinner/conf/layer.conf
```bitbake
BBPATH .= ":${LAYERDIR}"

BBFILES += "${LAYERDIR}/recipes-*/*/*.bb \
            ${LAYERDIR}/recipes-*/*/*.bbappend"

BBFILE_COLLECTIONS += "balena-allwinner"
BBFILE_PATTERN_balena-allwinner := "^${LAYERDIR}/"
BBFILE_PRIORITY_balena-allwinner = "1337"

KERNEL_IMAGETYPES:balena-allwinner = "Image"
KERNEL_CLASSES:balena-allwinner = "kernel-uimage"

LAYERSERIES_COMPAT_balena-allwinner = "dunfell honister kirkstone scarthgap"
```

## layers/meta-balena-allwinner/recipes-bsp/u-boot/files/ty33a_8g1g_defconfig
```kconfig
CONFIG_ARM=y
CONFIG_ARCH_SUNXI=y
CONFIG_NR_DRAM_BANKS=1
CONFIG_SPL=y
CONFIG_MACH_SUN8I_A33=y
CONFIG_DRAM_CLK=600
CONFIG_DRAM_ZQ=15291
CONFIG_DRAM_ODT_EN=y
CONFIG_MMC0_CD_PIN="!PB4"
CONFIG_USB0_ID_DET="PH8"
# CONFIG_SYS_MALLOC_CLEAR_ON_INIT is not set
CONFIG_USE_PREBOOT=y
# CONFIG_SPL_DOS_PARTITION is not set
# CONFIG_SPL_PARTITION_UUIDS is not set

CONFIG_SPL_MMC_SUPPORT=y
CONFIG_SPL_MMC_SUNXI=y
CONFIG_SYS_MMC_ENV_DEV=2
CONFIG_SPL_FAT_SUPPORT=y

CONFIG_DEFAULT_DEVICE_TREE="sun8i-a33-ty33a-8g1g"
CONFIG_SYS_RELOC_GD_ENV_ADDR=y
CONFIG_FASTBOOT_CMD_OEM_FORMAT=y
CONFIG_USB_EHCI_HCD=y
CONFIG_USB_OHCI_HCD=y
CONFIG_USB_MUSB_GADGET=y
CONFIG_USB_FUNCTION_MASS_STORAGE=y
CONFIG_ENV_IS_IN_MMC=y
CONFIG_ENV_MMC_PART=1
CONFIG_MMC_SUNXI_SLOT_EXTRA=2
CONFIG_SPL_LIBDISK_SUPPORT=y
# Force MMC device order
CONFIG_DM_MMC=y
```

## layers/meta-balena-allwinner/recipes-bsp/u-boot/u-boot/ty33a_8g1g_defconfig
```kconfig
CONFIG_ARM=y
CONFIG_ARCH_SUNXI=y
CONFIG_NR_DRAM_BANKS=1
CONFIG_SPL=y
CONFIG_MACH_SUN8I_A33=y
CONFIG_DRAM_CLK=600
CONFIG_DRAM_ZQ=15291
CONFIG_DRAM_ODT_EN=y
CONFIG_MMC0_CD_PIN="!PB4"
CONFIG_USB0_ID_DET="PH8"
# CONFIG_SYS_MALLOC_CLEAR_ON_INIT is not set
CONFIG_USE_PREBOOT=y
# CONFIG_SPL_DOS_PARTITION is not set
# CONFIG_SPL_PARTITION_UUIDS is not set

CONFIG_SPL_MMC_SUPPORT=y
CONFIG_SPL_MMC_SUNXI=y
CONFIG_SYS_MMC_ENV_DEV=2
CONFIG_SPL_FAT_SUPPORT=y

CONFIG_DEFAULT_DEVICE_TREE="sun8i-a33-ty33a-8g1g"
CONFIG_SYS_RELOC_GD_ENV_ADDR=y
CONFIG_FASTBOOT_CMD_OEM_FORMAT=y
CONFIG_USB_EHCI_HCD=y
CONFIG_USB_EHCI_SUNXI=y
CONFIG_USB_OHCI_HCD=y
CONFIG_USB_MUSB_GADGET=y
CONFIG_USB=y
CONFIG_CONSOLE_MUX=y
CONFIG_USB_TTY=y
CONFIG_USB_GADGET=y
CONFIG_USB_MUSB_HDRC=y
CONFIG_USB_MUSB_SUNXI=y
CONFIG_USB_FUNCTION_SERIAL=y
CONFIG_USB_FUNCTION_ACM=y
CONFIG_USB_KEYBOARD=y
CONFIG_USB_KBD=y
CONFIG_CMD_USB_ACM_CONSOLE=y
CONFIG_ENV_IS_IN_MMC=y
CONFIG_ENV_MMC_PART=1
CONFIG_MMC_SUNXI_SLOT_EXTRA=2
CONFIG_SPL_LIBDISK_SUPPORT=y
# Force MMC device order
CONFIG_DM_MMC=y


# Core video
CONFIG_VIDEO=y
CONFIG_DM_VIDEO=y
CONFIG_SYS_WHITE_ON_BLACK=y
CONFIG_VIDEO_LOGO=y

# Sunxi display engine
CONFIG_VIDEO_SUNXI=y

# Use LVDS panel output
CONFIG_VIDEO_LCD_PANEL_LVDS=y
# Pixel clock phase often needs 1 on LVDS
CONFIG_VIDEO_LCD_DCLK_PHASE=1

# Your panel timing (from your kernel DTS: 1280x800, 68.544 MHz, 18-bit)
CONFIG_VIDEO_LCD_MODE="x:1280,y:800,depth:18,pclk_khz:68544,le:32,ri:24,up:1,lo:3,hs:32,vs:6,sync:3,vmode:0"

# Backlight control (you have PH0 PWM, PH6 EN; PWM is inverted in Linux)
CONFIG_VIDEO_LCD_BL_PWM="PH0"
CONFIG_VIDEO_LCD_BL_PWM_ACTIVE_LOW=y
CONFIG_VIDEO_LCD_BL_EN="PH6"

CONFIG_DM_USB=y
CONFIG_DM_HID=y
CONFIG_DM_REGULATOR=y
CONFIG_DM_REGULATOR_FIXED=y
CONFIG_USB_HID_BOOT_PROTOCOL=y
```
